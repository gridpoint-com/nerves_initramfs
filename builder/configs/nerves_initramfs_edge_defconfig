## builder/configs/nerves_initramfs_edge_defconfig
```kconfig
BR2_arm=y
BR2_TOOLCHAIN_EXTERNAL=y
BR2_GLOBAL_PATCH_DIR="${BR2_EXTERNAL_CUSTOM_PATH}/patches"
BR2_INIT_NONE=y
# BR2_TARGET_ENABLE_ROOT_LOGIN is not set
# BR2_TARGET_GENERIC_GETTY is not set
BR2_ROOTFS_POST_BUILD_SCRIPT="${BR2_EXTERNAL_CUSTOM_PATH}/board/nerves_initramfs/post-build.sh ${BR2_EXTERNAL_CUSTOM_PATH}/board/nerves_initramfs_edge/post-build.sh"
BR2_ROOTFS_POST_SCRIPT_ARGS="nerves_initramfs_edge.conf"
BR2_PACKAGE_BUSYBOX_CONFIG="${BR2_EXTERNAL}/busybox/busybox.config"
BR2_PACKAGE_E2FSPROGS=y
BR2_PACKAGE_FWUP=y
BR2_PACKAGE_READLINE=y
# BR2_PACKAGE_IFUPDOWN_SCRIPTS is not set
BR2_TARGET_ROOTFS_CPIO=y
BR2_TARGET_ROOTFS_CPIO_XZ=y
BR2_TARGET_ROOTFS_CPIO_UIMAGE=y
# BR2_TARGET_ROOTFS_TAR is not set
BR2_PACKAGE_NERVES_INITRAMFS=y
```
